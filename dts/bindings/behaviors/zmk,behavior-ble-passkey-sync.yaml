## dts/bindings/behaviors/zmk,behavior-ble-passkey-sync.yaml
```yaml
description: BLE Passkey Sync Behavior
compatible: "zmk,behavior-ble-passkey-sync"
properties:
  "#binding-cells":
    type: int
    const: 2
```

## dts/bindings/zmk,ble-passkey-layer.yaml
```yaml
description: "BLE Passkey auto-layer toggle settings"
compatible: "zmk,ble-passkey-layer"

properties:
  passkey-layer:
    type: int
    required: true
    description: "The layer ID to activate when passkey entry begins"
  exclude-layers:
    type: array
    required: false
    description: "List of layer IDs that, if active, will prevent the passkey layer from activating"
```
